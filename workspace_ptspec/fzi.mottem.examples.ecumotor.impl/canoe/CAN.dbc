VERSION ""

NS_ :

BS_:

BU_:

BO_ 6 Rx_ControlParams_fb: 8 Vector__XXX
 SG_ k_i_act : 39|32@0- (1,0) [0|0] "" Vector__XXX
 SG_ k_p_act : 7|32@0- (1,0) [0|0] "" Vector__XXX

BO_ 1 Tx_ControlParams: 8 Vector__XXX
 SG_ k_i_tar : 39|32@0- (1,0) [0|0] "" Vector__XXX
 SG_ k_p_tar : 7|32@0- (1,0) [0|0] "" Vector__XXX

BO_ 5 Rx_TargetValues: 8 Vector__XXX
 SG_ rpm_tar_act : 39|32@0- (1,0) [0|0] "" Vector__XXX
 SG_ rpm_tar_CAN : 7|32@0- (1,0) [0|0] "" Vector__XXX

BO_ 0 Tx_SpeedTarget: 4 Vector__XXX
 SG_ rpm_tar : 7|32@0- (1,0) [0|0] "" Vector__XXX

BO_ 4 Rx_MotorInfo: 8 Vector__XXX
 SG_ pwm_dc : 39|32@0- (1,0) [0|0] "" Vector__XXX
 SG_ rpm_act : 7|32@0- (1,0) [0|0] "" Vector__XXX

BA_DEF_  "BusType" STRING ;
BA_DEF_DEF_  "BusType" "CAN";
SIG_VALTYPE_ 6 k_i_act : 1;
SIG_VALTYPE_ 6 k_p_act : 1;
SIG_VALTYPE_ 1 k_i_tar : 1;
SIG_VALTYPE_ 1 k_p_tar : 1;
SIG_VALTYPE_ 4 pwm_dc : 1;
SIG_VALTYPE_ 4 rpm_act : 1;
